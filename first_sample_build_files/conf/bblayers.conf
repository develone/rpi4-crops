## first_sample_build_files/conf/bblayers.conf
```bitbake
# POKY_BBLAYERS_CONF_VERSION is increased each time build/conf/bblayers.conf
# changes incompatibly
POKY_BBLAYERS_CONF_VERSION = "2"

BBPATH = "${TOPDIR}"
BBFILES ?= ""

BBLAYERS ?= " \
  /work-cuteradio/rpi4-crops/sources/poky/meta \
  /work-cuteradio/rpi4-crops/sources/poky/meta-poky \
  /work-cuteradio/rpi4-crops/sources/poky/meta-yocto-bsp \
  "
```

## first_sample_build_files/conf/bblayers.conf.sample
```bitbake
# POKY_BBLAYERS_CONF_VERSION is increased each time build/conf/bblayers.conf
# changes incompatibly
POKY_BBLAYERS_CONF_VERSION = "3"

BBPATH = "${TOPDIR}"
BBFILES ?= ""

BBLAYERS ?= " \
  /work-cuteradio/rpi4-crops/sources/poky/meta \
  /work-cuteradio/rpi4-crops/sources/poky/meta-poky \
  /work-cuteradio/rpi4-crops/sources/poky/meta-yocto-bsp \
  /work-cuteradio/rpi4-crops/sources/meta-openembedded/meta-oe \
  /work-cuteradio/rpi4-crops/sources/meta-openembedded/meta-python \
  /work-cuteradio/rpi4-crops/sources/meta-openembedded/meta-multimedia \
  /work-cuteradio/rpi4-crops/sources/meta-raspberrypi \
"
```
